## boards/dsmr_splitter/Kconfig
```kconfig
# Copyright (c) 2022 Bas Stottelaar <basstottelaar@gmail.com>
#
# This file is subject to the terms and conditions of the GNU Lesser
# General Public License v2.1. See the file LICENSE in the top level
# directory for more details.

config BOARD
    default "dsmr_splitter" if BOARD_DSMR_SPLITTER

config BOARD_DSMR_SPLITTER
    bool
    default y
    select CPU_MODEL_EFM32PG12B500F1024GM48
    select HAS_PERIPH_ADC
    select HAS_PERIPH_RTC
    select HAS_PERIPH_RTT
    select HAS_PERIPH_TIMER
    select HAS_PERIPH_UART
    select HAS_PERIPH_UART_MODECFG
    select HAS_EFM32_CORETEMP
    select HAS_RIOTBOOT
```

## drivers/dsmr/Kconfig
```kconfig
# Copyright (c) 2021 Bas Stottelaar <basstottelaar@gmail.com>
#
# This file is subject to the terms and conditions of the GNU Lesser
# General Public License v2.1. See the file LICENSE in the top level
# directory for more details.
#

config MODULE_DSMR
    bool "Dutch Smart Meter (DSMR) device driver"
    depends on HAS_PERIPH_GPIO
    depends on HAS_PERIPH_UART
    depends on TEST_KCONFIG
    select MODULE_PERIPH_GPIO
    select MODULE_PERIPH_UART
    select MODULE_CHECKSUM
    select MODULE_XTIMER
```
